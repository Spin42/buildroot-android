## buildroot-external/Config.in
```kconfig
source "$BR2_EXTERNAL_ANDROID_PATH/package/fp2-firmware/Config.in"
source "$BR2_EXTERNAL_ANDROID_PATH/package/fp3-firmware/Config.in"
source "$BR2_EXTERNAL_ANDROID_PATH/package/grate-firmware/Config.in"
source "$BR2_EXTERNAL_ANDROID_PATH/package/qrtr/Config.in"
source "$BR2_EXTERNAL_ANDROID_PATH/package/rmtfs/Config.in"
source "$BR2_EXTERNAL_ANDROID_PATH/package/sim-selector/Config.in"
source "$BR2_EXTERNAL_ANDROID_PATH/package/citros-initramfs/Config.in"
source "$BR2_EXTERNAL_ANDROID_PATH/package/rpmsgexport/Config.in"
source "$BR2_EXTERNAL_ANDROID_PATH/package/first-boot-resize/Config.in"
source "$BR2_EXTERNAL_ANDROID_PATH/package/unudhcpd/Config.in"
source "$BR2_EXTERNAL_ANDROID_PATH/package/alsa-ucm-conf/Config.in"
source "$BR2_EXTERNAL_ANDROID_PATH/package/tqftpserv/Config.in"
source "$BR2_EXTERNAL_ANDROID_PATH/package/hexagonrpc/Config.in"
source "$BR2_EXTERNAL_ANDROID_PATH/package/reboot-mode/Config.in"
source "$BR2_EXTERNAL_ANDROID_PATH/package/s3ve3g-firmware/Config.in"
source "$BR2_EXTERNAL_ANDROID_PATH/package/adsp-boot/Config.in"
source "$BR2_EXTERNAL_ANDROID_PATH/package/tb3-tools/Config.in"
source "$BR2_EXTERNAL_ANDROID_PATH/package/tb3-gpu-test/Config.in"
source "$BR2_EXTERNAL_ANDROID_PATH/package/tb3-audio/Config.in"
source "$BR2_EXTERNAL_ANDROID_PATH/package/tb3-bluetooth/Config.in"
source "$BR2_EXTERNAL_ANDROID_PATH/package/tb3-firmware/Config.in"

menu "MediaTek MT8127 connectivity (CONSYS WiFi)"
source "$BR2_EXTERNAL_ANDROID_PATH/package/mt8127-btif/Config.in"
source "$BR2_EXTERNAL_ANDROID_PATH/package/mt8127-consys/Config.in"
source "$BR2_EXTERNAL_ANDROID_PATH/package/mt8127-wmt/Config.in"
source "$BR2_EXTERNAL_ANDROID_PATH/package/mt8127-wlan/Config.in"
source "$BR2_EXTERNAL_ANDROID_PATH/package/mt8127-bt/Config.in"
source "$BR2_EXTERNAL_ANDROID_PATH/package/mt8127-fm/Config.in"
source "$BR2_EXTERNAL_ANDROID_PATH/package/mt8127-camera/Config.in"
source "$BR2_EXTERNAL_ANDROID_PATH/package/tb3-wifi/Config.in"
endmenu
```

## buildroot-external/configs/fairphone2_uboot_rauc_defconfig
```kconfig
BR2_arm=y
BR2_cortex_a15=y
BR2_ARM_FPU_NEON_VFPV4=y
BR2_TOOLCHAIN_EXTERNAL=y
BR2_TOOLCHAIN_EXTERNAL_BOOTLIN=y
BR2_GNU_MIRROR="http://ftpmirror.gnu.org"
BR2_GLOBAL_PATCH_DIR="$(BR2_EXTERNAL_ANDROID_PATH)/board/fairphone2/patches"
BR2_ROOTFS_DEVICE_CREATION_DYNAMIC_EUDEV=y
BR2_TARGET_GENERIC_ROOT_PASSWD="root"
BR2_TARGET_GENERIC_GETTY_PORT="tty1"
BR2_LINUX_KERNEL=y
BR2_LINUX_KERNEL_CUSTOM_GIT=y
BR2_LINUX_KERNEL_CUSTOM_REPO_URL="https://github.com/msm8974-mainline/linux"
BR2_LINUX_KERNEL_CUSTOM_REPO_VERSION="v6.11.4-msm8974"
BR2_LINUX_KERNEL_USE_CUSTOM_CONFIG=y
BR2_LINUX_KERNEL_CUSTOM_CONFIG_FILE="$(BR2_EXTERNAL_ANDROID_PATH)/board/fairphone2/linux.config"
BR2_LINUX_KERNEL_CONFIG_FRAGMENT_FILES="$(BR2_EXTERNAL_ANDROID_PATH)/board/fairphone2/rauc/linux.fragment"
BR2_LINUX_KERNEL_DTS_SUPPORT=y
BR2_LINUX_KERNEL_INTREE_DTS_NAME="qcom/qcom-msm8974pro-fairphone-fp2"
BR2_LINUX_KERNEL_DTB_OVERLAY_SUPPORT=y
BR2_LINUX_KERNEL_INSTALL_TARGET=y
BR2_PACKAGE_BUSYBOX_SHOW_OTHERS=y
BR2_PACKAGE_E2FSPROGS=y
BR2_PACKAGE_E2FSPROGS_RESIZE2FS=y
BR2_PACKAGE_GENEXT2FS=y
BR2_PACKAGE_LINUX_FIRMWARE=y
BR2_PACKAGE_LINUX_FIRMWARE_QCOM_ADRENO=y
BR2_PACKAGE_KBD=y
BR2_PACKAGE_USBUTILS=y
BR2_PACKAGE_ELL=y
BR2_PACKAGE_BLUEZ_TOOLS=y
BR2_PACKAGE_BLUEZ5_UTILS=y
BR2_PACKAGE_BLUEZ5_UTILS_CLIENT=y
BR2_PACKAGE_BLUEZ5_UTILS_TOOLS=y
BR2_PACKAGE_BLUEZ5_UTILS_PLUGINS_HID=y
BR2_PACKAGE_DHCP=y
BR2_PACKAGE_DHCP_SERVER=y
BR2_PACKAGE_IPTABLES=y
BR2_PACKAGE_MODEM_MANAGER_LIBQRTR=y
BR2_PACKAGE_NETWORK_MANAGER=y
BR2_PACKAGE_NETWORK_MANAGER_TUI=y
BR2_PACKAGE_NETWORK_MANAGER_CLI=y
BR2_PACKAGE_NETWORK_MANAGER_MODEM_MANAGER=y
BR2_PACKAGE_OPENSSH=y
BR2_PACKAGE_WIRELESS_REGDB=y
BR2_PACKAGE_WIRELESS_TOOLS=y
BR2_PACKAGE_WPA_SUPPLICANT=y
BR2_PACKAGE_WPA_SUPPLICANT_AP_SUPPORT=y
BR2_PACKAGE_WPA_SUPPLICANT_EAP=y
BR2_PACKAGE_WPA_SUPPLICANT_WPS=y
BR2_PACKAGE_WPA_SUPPLICANT_WPA3=y
BR2_PACKAGE_WPA_SUPPLICANT_CLI=y
BR2_PACKAGE_WPA_SUPPLICANT_WPA_CLIENT_SO=y
BR2_PACKAGE_WPA_SUPPLICANT_PASSPHRASE=y
BR2_PACKAGE_WPA_SUPPLICANT_DBUS=y
BR2_TARGET_ROOTFS_EXT2=y
# BR2_TARGET_ROOTFS_TAR is not set
BR2_TARGET_UBOOT=y
BR2_TARGET_UBOOT_BUILD_SYSTEM_KCONFIG=y
BR2_TARGET_UBOOT_CUSTOM_GIT=y
BR2_TARGET_UBOOT_CUSTOM_REPO_URL="https://source.denx.de/u-boot/u-boot.git"
BR2_TARGET_UBOOT_CUSTOM_REPO_VERSION="5e3b01c8466dbe45cd6a06299f8f4c7e8c1c2363"
BR2_TARGET_UBOOT_BOARD_DEFCONFIG="fairphone-fp2"
BR2_TARGET_UBOOT_NEEDS_OPENSSL=y
BR2_PACKAGE_HOST_GENIMAGE=y
BR2_PACKAGE_FP2_FIRMWARE=y
BR2_PACKAGE_QRTR=y
BR2_PACKAGE_RMTFS=y
BR2_PACKAGE_SIM_SELECTOR=y
BR2_PACKAGE_UNUDHCPD=y
BR2_ROOTFS_OVERLAY="$(BR2_EXTERNAL_ANDROID_PATH)/board/fairphone2/overlay $(BR2_EXTERNAL_ANDROID_PATH)/board/fairphone2/rauc/overlay"
BR2_ROOTFS_POST_BUILD_SCRIPT="$(BR2_EXTERNAL_ANDROID_PATH)/board/fairphone2/rauc/post-build.sh"
BR2_ROOTFS_POST_IMAGE_SCRIPT="$(BR2_EXTERNAL_ANDROID_PATH)/board/fairphone2/scripts/post-image-uboot.sh $(BR2_EXTERNAL_ANDROID_PATH)/board/fairphone2/rauc/post-image.sh"
BR2_ROOTFS_POST_SCRIPT_ARGS="-c $(BR2_EXTERNAL_ANDROID_PATH)/board/fairphone2/rauc/genimage.cfg"
BR2_TARGET_ROOTFS_EXT2_4=y
BR2_TARGET_ROOTFS_EXT2_SIZE="400M"
BR2_PACKAGE_RAUC=y
BR2_PACKAGE_HOST_DOSFSTOOLS=y
BR2_PACKAGE_HOST_MTOOLS=y
BR2_PACKAGE_HOST_RAUC=y
BR2_PACKAGE_HOST_UBOOT_TOOLS=y
BR2_PACKAGE_HOST_UBOOT_TOOLS_BOOT_SCRIPT=y
BR2_PACKAGE_HOST_UBOOT_TOOLS_BOOT_SCRIPT_SOURCE="$(BR2_EXTERNAL_ANDROID_PATH)/board/fairphone2/rauc/boot.cmd"
```

## buildroot-external/configs/rescue_aarch64_defconfig
```kconfig
BR2_aarch64=y
BR2_TOOLCHAIN_EXTERNAL=y
BR2_TOOLCHAIN_EXTERNAL_CUSTOM=y
BR2_TOOLCHAIN_EXTERNAL_DOWNLOAD=y
BR2_TOOLCHAIN_EXTERNAL_URL="https://github.com/nerves-project/toolchains/releases/download/v14.2.0/nerves_toolchain_aarch64_nerves_linux_gnu-linux_x86_64-14.2.0-C3B80E7.tar.xz"
BR2_TOOLCHAIN_EXTERNAL_CUSTOM_PREFIX="aarch64-nerves-linux-gnu"
BR2_TOOLCHAIN_EXTERNAL_GCC_14=y
BR2_TOOLCHAIN_EXTERNAL_HEADERS_5_4=y
BR2_TOOLCHAIN_EXTERNAL_CUSTOM_GLIBC=y
# BR2_TOOLCHAIN_EXTERNAL_INET_RPC is not set
BR2_TOOLCHAIN_EXTERNAL_CXX=y
BR2_TOOLCHAIN_EXTERNAL_FORTRAN=y
BR2_TOOLCHAIN_EXTERNAL_OPENMP=y
BR2_TARGET_GENERIC_HOSTNAME="rescue"
BR2_TARGET_GENERIC_ROOT_PASSWD="root"
BR2_INIT_NONE=y
BR2_SYSTEM_BIN_SH_BUSYBOX=y
BR2_ROOTFS_OVERLAY="$(BR2_EXTERNAL_ANDROID_PATH)/board/common/rescue/overlay-common $(BR2_EXTERNAL_ANDROID_PATH)/board/common/rescue/overlay-rescue"
BR2_PACKAGE_BUSYBOX_CONFIG_FRAGMENT_FILES="$(BR2_EXTERNAL_ANDROID_PATH)/board/common/rescue/busybox.fragment"
BR2_PACKAGE_BUSYBOX_SHOW_OTHERS=y
BR2_PACKAGE_UNUDHCPD=y
BR2_PACKAGE_REBOOT_MODE=y
BR2_PACKAGE_DROPBEAR=y
BR2_PACKAGE_E2FSPROGS=y
BR2_PACKAGE_E2FSPROGS_RESIZE2FS=y
BR2_PACKAGE_I2C_TOOLS=y
BR2_PACKAGE_EVTEST=y
BR2_PACKAGE_UTIL_LINUX=y
BR2_PACKAGE_UTIL_LINUX_BINARIES=y
BR2_TARGET_ROOTFS_CPIO=y
BR2_TARGET_ROOTFS_CPIO_GZIP=y
# BR2_TARGET_ROOTFS_TAR is not set
```

## buildroot-external/configs/rescue_armv7_defconfig
```kconfig
BR2_arm=y
BR2_cortex_a8=y
BR2_ARM_FPU_VFPV3D16=y
BR2_ARM_EABIHF=y
BR2_TOOLCHAIN_EXTERNAL=y
BR2_TOOLCHAIN_EXTERNAL_CUSTOM=y
BR2_TOOLCHAIN_EXTERNAL_DOWNLOAD=y
BR2_TOOLCHAIN_EXTERNAL_URL="https://github.com/nerves-project/toolchains/releases/download/v14.2.0/nerves_toolchain_armv7_nerves_linux_gnueabihf-linux_x86_64-14.2.0-6442318.tar.xz"
BR2_TOOLCHAIN_EXTERNAL_CUSTOM_PREFIX="armv7-nerves-linux-gnueabihf"
BR2_TOOLCHAIN_EXTERNAL_GCC_14=y
BR2_TOOLCHAIN_EXTERNAL_HEADERS_5_4=y
BR2_TOOLCHAIN_EXTERNAL_CUSTOM_GLIBC=y
# BR2_TOOLCHAIN_EXTERNAL_INET_RPC is not set
BR2_TOOLCHAIN_EXTERNAL_CXX=y
BR2_TOOLCHAIN_EXTERNAL_FORTRAN=y
BR2_TOOLCHAIN_EXTERNAL_OPENMP=y
BR2_TARGET_GENERIC_HOSTNAME="rescue"
BR2_TARGET_GENERIC_ROOT_PASSWD="root"
BR2_INIT_NONE=y
BR2_SYSTEM_BIN_SH_BUSYBOX=y
BR2_ROOTFS_OVERLAY="$(BR2_EXTERNAL_ANDROID_PATH)/board/common/rescue/overlay-common $(BR2_EXTERNAL_ANDROID_PATH)/board/common/rescue/overlay-rescue"
BR2_PACKAGE_BUSYBOX_CONFIG_FRAGMENT_FILES="$(BR2_EXTERNAL_ANDROID_PATH)/board/common/rescue/busybox.fragment"
BR2_PACKAGE_BUSYBOX_SHOW_OTHERS=y
BR2_PACKAGE_UNUDHCPD=y
BR2_PACKAGE_REBOOT_MODE=y
BR2_PACKAGE_DROPBEAR=y
BR2_PACKAGE_E2FSPROGS=y
BR2_PACKAGE_E2FSPROGS_RESIZE2FS=y
BR2_PACKAGE_I2C_TOOLS=y
BR2_PACKAGE_EVTEST=y
BR2_PACKAGE_UTIL_LINUX=y
BR2_PACKAGE_UTIL_LINUX_BINARIES=y
BR2_TARGET_ROOTFS_CPIO=y
BR2_TARGET_ROOTFS_CPIO_GZIP=y
# BR2_TARGET_ROOTFS_TAR is not set
```

## buildroot-external/configs/s3ve3g_defconfig
```kconfig
BR2_arm=y
BR2_cortex_a7=y
BR2_ARM_FPU_NEON_VFPV4=y
BR2_KERNEL_HEADERS_6_12=y
BR2_TARGET_GENERIC_HOSTNAME="s3ve3g"
BR2_TARGET_GENERIC_ISSUE="Samsung Galaxy S III Neo (GT-I9301I) persistent"
BR2_TARGET_GENERIC_ROOT_PASSWD="root"
# BR2_TARGET_GENERIC_GETTY is not set
BR2_ROOTFS_OVERLAY="$(BR2_EXTERNAL_ANDROID_PATH)/board/s3ve3g/overlay"
BR2_ROOTFS_POST_BUILD_SCRIPT="$(BR2_EXTERNAL_ANDROID_PATH)/board/s3ve3g/scripts/post_build.sh"
BR2_ROOTFS_POST_IMAGE_SCRIPT="$(BR2_EXTERNAL_ANDROID_PATH)/board/s3ve3g/scripts/create_userdata_image.sh"
BR2_LINUX_KERNEL=y
BR2_LINUX_KERNEL_CUSTOM_GIT=y
BR2_LINUX_KERNEL_CUSTOM_REPO_URL="https://github.com/msm8226-mainline/linux"
BR2_LINUX_KERNEL_CUSTOM_REPO_VERSION="57a693c8bfc6ba8dd9f737b10b8fff2c6d3484c8"
BR2_LINUX_KERNEL_PATCH="$(BR2_EXTERNAL_ANDROID_PATH)/board/s3ve3g/linux-patches"
BR2_LINUX_KERNEL_USE_CUSTOM_CONFIG=y
BR2_LINUX_KERNEL_CUSTOM_CONFIG_FILE="$(BR2_EXTERNAL_ANDROID_PATH)/board/s3ve3g/linux.config"
BR2_LINUX_KERNEL_XZ=y
BR2_LINUX_KERNEL_DTS_SUPPORT=y
BR2_LINUX_KERNEL_INTREE_DTS_NAME="qcom/qcom-msm8226-samsung-s3ve3g"
BR2_LINUX_KERNEL_INSTALL_TARGET=y
BR2_LINUX_KERNEL_NEEDS_HOST_OPENSSL=y
BR2_PACKAGE_BUSYBOX_CONFIG_FRAGMENT_FILES="$(BR2_EXTERNAL_ANDROID_PATH)/board/s3ve3g/busybox-rescue.fragment"
BR2_PACKAGE_BUSYBOX_SHOW_OTHERS=y
BR2_PACKAGE_STRACE=y
BR2_PACKAGE_DOSFSTOOLS=y
BR2_PACKAGE_DOSFSTOOLS_FATLABEL=y
BR2_PACKAGE_DOSFSTOOLS_FSCK_FAT=y
BR2_PACKAGE_DOSFSTOOLS_MKFS_FAT=y
BR2_PACKAGE_E2FSPROGS=y
BR2_PACKAGE_E2FSPROGS_RESIZE2FS=y
BR2_PACKAGE_F2FS_TOOLS=y
BR2_PACKAGE_MMC_UTILS=y
BR2_PACKAGE_EVTEST=y
BR2_PACKAGE_I2C_TOOLS=y
BR2_PACKAGE_DTC=y
BR2_PACKAGE_DTC_PROGRAMS=y
BR2_PACKAGE_NCURSES_ADDITIONAL_TERMINFO="x/xterm-256color"
BR2_PACKAGE_DROPBEAR=y
# BR2_PACKAGE_DROPBEAR_CLIENT is not set
BR2_PACKAGE_ETHTOOL=y
BR2_PACKAGE_IW=y
BR2_PACKAGE_WIRELESS_REGDB=y
BR2_PACKAGE_WPA_SUPPLICANT=y
BR2_PACKAGE_WPA_SUPPLICANT_AP_SUPPORT=y
BR2_PACKAGE_WPA_SUPPLICANT_EAP=y
BR2_PACKAGE_WPA_SUPPLICANT_WPS=y
BR2_PACKAGE_WPA_SUPPLICANT_WPA3=y
BR2_PACKAGE_WPA_SUPPLICANT_CLI=y
BR2_PACKAGE_WPA_SUPPLICANT_WPA_CLIENT_SO=y
BR2_PACKAGE_WPA_SUPPLICANT_PASSPHRASE=y
BR2_PACKAGE_HTOP=y
BR2_PACKAGE_KMOD=y
BR2_PACKAGE_KMOD_TOOLS=y
BR2_PACKAGE_UTIL_LINUX_BINARIES=y
BR2_TARGET_ROOTFS_EXT2=y
BR2_TARGET_ROOTFS_EXT2_LABEL="s3ve3g"
BR2_TARGET_ROOTFS_EXT2_SIZE="512M"
BR2_TARGET_ROOTFS_EXT2_MKFS_OPTIONS="-O ^64bit,^has_journal,^extent,^flex_bg,^huge_file,^dir_nlink,^extra_isize,^metadata_csum,^uninit_bg"
# BR2_TARGET_ROOTFS_TAR is not set
BR2_PACKAGE_HOST_ZSTD=y
BR2_PACKAGE_UNUDHCPD=y
BR2_PACKAGE_REBOOT_MODE=y
BR2_PACKAGE_S3VE3G_FIRMWARE=y
```

## buildroot-external/configs/s3ve3g_firstlight_defconfig
```kconfig
BR2_arm=y
BR2_cortex_a7=y
BR2_ARM_FPU_NEON_VFPV4=y
BR2_TOOLCHAIN_BUILDROOT_GLIBC=y
BR2_KERNEL_HEADERS_6_12=y
BR2_TARGET_GENERIC_HOSTNAME="s3ve3g"
BR2_TARGET_GENERIC_ISSUE="Samsung Galaxy S III Neo (GT-I9301I) first light"
BR2_INIT_NONE=y
BR2_ROOTFS_DEVICE_CREATION_DYNAMIC_DEVTMPFS=y
BR2_ROOTFS_OVERLAY="$(BR2_EXTERNAL_ANDROID_PATH)/board/s3ve3g/firstlight-overlay"
BR2_ROOTFS_POST_BUILD_SCRIPT="$(BR2_EXTERNAL_ANDROID_PATH)/board/s3ve3g/scripts/firstlight_post_build.sh"
BR2_ROOTFS_POST_IMAGE_SCRIPT="$(BR2_EXTERNAL_ANDROID_PATH)/board/s3ve3g/scripts/create_boot_image.sh"
BR2_LINUX_KERNEL=y
BR2_LINUX_KERNEL_CUSTOM_GIT=y
BR2_LINUX_KERNEL_CUSTOM_REPO_URL="https://github.com/msm8226-mainline/linux"
BR2_LINUX_KERNEL_CUSTOM_REPO_VERSION="57a693c8bfc6ba8dd9f737b10b8fff2c6d3484c8"
BR2_LINUX_KERNEL_PATCH="$(BR2_EXTERNAL_ANDROID_PATH)/board/s3ve3g/linux-patches"
BR2_LINUX_KERNEL_USE_CUSTOM_CONFIG=y
BR2_LINUX_KERNEL_CUSTOM_CONFIG_FILE="$(BR2_EXTERNAL_ANDROID_PATH)/board/s3ve3g/linux.config"
BR2_LINUX_KERNEL_XZ=y
BR2_LINUX_KERNEL_DTS_SUPPORT=y
BR2_LINUX_KERNEL_INTREE_DTS_NAME="qcom/qcom-msm8226-samsung-s3ve3g"
BR2_LINUX_KERNEL_NEEDS_HOST_OPENSSL=y
BR2_PACKAGE_BUSYBOX_CONFIG_FRAGMENT_FILES="$(BR2_EXTERNAL_ANDROID_PATH)/board/s3ve3g/busybox-firstlight.fragment"
# BR2_TARGET_ROOTFS_TAR is not set
BR2_TARGET_ROOTFS_CPIO=y
BR2_TARGET_ROOTFS_CPIO_GZIP=y
```

## buildroot-external/configs/s3ve3g_rescue_defconfig
```kconfig
BR2_arm=y
BR2_cortex_a7=y
BR2_ARM_FPU_NEON_VFPV4=y
BR2_KERNEL_HEADERS_6_12=y
BR2_TARGET_GENERIC_HOSTNAME="s3ve3g-rescue"
BR2_TARGET_GENERIC_ISSUE="Samsung Galaxy S III Neo (GT-I9301I) rescue"
BR2_INIT_NONE=y
BR2_TARGET_GENERIC_ROOT_PASSWD="root"
BR2_ROOTFS_OVERLAY="$(BR2_EXTERNAL_ANDROID_PATH)/board/s3ve3g/rescue-overlay"
BR2_ROOTFS_POST_BUILD_SCRIPT="$(BR2_EXTERNAL_ANDROID_PATH)/board/s3ve3g/scripts/rescue_post_build.sh"
BR2_ROOTFS_POST_IMAGE_SCRIPT="$(BR2_EXTERNAL_ANDROID_PATH)/board/s3ve3g/scripts/create_boot_image.sh"
BR2_LINUX_KERNEL=y
BR2_LINUX_KERNEL_CUSTOM_GIT=y
BR2_LINUX_KERNEL_CUSTOM_REPO_URL="https://github.com/msm8226-mainline/linux"
BR2_LINUX_KERNEL_CUSTOM_REPO_VERSION="57a693c8bfc6ba8dd9f737b10b8fff2c6d3484c8"
BR2_LINUX_KERNEL_PATCH="$(BR2_EXTERNAL_ANDROID_PATH)/board/s3ve3g/linux-patches"
BR2_LINUX_KERNEL_USE_CUSTOM_CONFIG=y
BR2_LINUX_KERNEL_CUSTOM_CONFIG_FILE="$(BR2_EXTERNAL_ANDROID_PATH)/board/s3ve3g/linux.config"
BR2_LINUX_KERNEL_XZ=y
BR2_LINUX_KERNEL_DTS_SUPPORT=y
BR2_LINUX_KERNEL_INTREE_DTS_NAME="qcom/qcom-msm8226-samsung-s3ve3g"
BR2_LINUX_KERNEL_NEEDS_HOST_OPENSSL=y
BR2_PACKAGE_BUSYBOX_CONFIG_FRAGMENT_FILES="$(BR2_EXTERNAL_ANDROID_PATH)/board/s3ve3g/busybox-rescue.fragment"
BR2_PACKAGE_BUSYBOX_SHOW_OTHERS=y
BR2_PACKAGE_STRACE=y
BR2_PACKAGE_DOSFSTOOLS=y
BR2_PACKAGE_DOSFSTOOLS_FATLABEL=y
BR2_PACKAGE_DOSFSTOOLS_FSCK_FAT=y
BR2_PACKAGE_DOSFSTOOLS_MKFS_FAT=y
BR2_PACKAGE_E2FSPROGS=y
BR2_PACKAGE_F2FS_TOOLS=y
BR2_PACKAGE_MMC_UTILS=y
BR2_PACKAGE_EVTEST=y
BR2_PACKAGE_I2C_TOOLS=y
BR2_PACKAGE_DTC=y
BR2_PACKAGE_DTC_PROGRAMS=y
BR2_PACKAGE_NCURSES_ADDITIONAL_TERMINFO="x/xterm-256color"
BR2_PACKAGE_DROPBEAR=y
# BR2_PACKAGE_DROPBEAR_CLIENT is not set
BR2_PACKAGE_ETHTOOL=y
BR2_PACKAGE_HTOP=y
BR2_PACKAGE_KMOD=y
BR2_PACKAGE_KMOD_TOOLS=y
BR2_PACKAGE_UTIL_LINUX_BINARIES=y
BR2_TARGET_ROOTFS_CPIO=y
BR2_TARGET_ROOTFS_CPIO_XZ=y
# BR2_TARGET_ROOTFS_TAR is not set
BR2_PACKAGE_HOST_ZSTD=y
BR2_PACKAGE_UNUDHCPD=y
```
