## buildroot-external/configs/samsung-expressatt_defconfig
```kconfig
BR2_arm=y
BR2_cortex_a15=y
BR2_ARM_FPU_NEON_VFPV4=y
BR2_TOOLCHAIN_BUILDROOT_MUSL=y
BR2_KERNEL_HEADERS_AS_KERNEL=y
BR2_PACKAGE_HOST_LINUX_HEADERS_CUSTOM_7_1=y
BR2_TARGET_GENERIC_HOSTNAME="expressatt"
BR2_TARGET_GENERIC_ISSUE="Samsung Express Buildroot Linux"
BR2_TARGET_GENERIC_ROOT_PASSWD="root"
BR2_INIT_BUSYBOX=y
BR2_ROOTFS_DEVICE_CREATION_DYNAMIC_DEVTMPFS=y
BR2_TARGET_GENERIC_GETTY_PORT="tty1"
BR2_ROOTFS_OVERLAY="$(BR2_EXTERNAL_ANDROID_PATH)/board/samsung-expressatt/firstlight-overlay $(BR2_EXTERNAL_ANDROID_PATH)/board/samsung-expressatt/overlay"
BR2_ROOTFS_POST_BUILD_SCRIPT="$(BR2_EXTERNAL_ANDROID_PATH)/board/samsung-expressatt/system-post-build.sh"
BR2_ROOTFS_POST_IMAGE_SCRIPT="$(BR2_EXTERNAL_ANDROID_PATH)/board/samsung-expressatt/system-post-image.sh"
BR2_LINUX_KERNEL=y
BR2_LINUX_KERNEL_CUSTOM_GIT=y
BR2_LINUX_KERNEL_CUSTOM_REPO_URL="https://git.kernel.org/pub/scm/linux/kernel/git/stable/linux.git"
BR2_LINUX_KERNEL_CUSTOM_REPO_VERSION="5fce161649b4d779d1b76d9fcd52dc77779774b8"
BR2_LINUX_KERNEL_PATCH="$(BR2_EXTERNAL_ANDROID_PATH)/board/samsung-expressatt/linux-patches"
BR2_LINUX_KERNEL_USE_CUSTOM_CONFIG=y
BR2_LINUX_KERNEL_CUSTOM_CONFIG_FILE="$(BR2_EXTERNAL_ANDROID_PATH)/board/samsung-expressatt/linux.config"
BR2_LINUX_KERNEL_CONFIG_FRAGMENT_FILES="$(BR2_EXTERNAL_ANDROID_PATH)/board/samsung-expressatt/linux-firstlight.fragment $(BR2_EXTERNAL_ANDROID_PATH)/board/samsung-expressatt/linux-system.fragment"
BR2_LINUX_KERNEL_DTS_SUPPORT=y
BR2_LINUX_KERNEL_INTREE_DTS_NAME="qcom/qcom-msm8960-samsung-expressatt"
BR2_LINUX_KERNEL_INSTALL_TARGET=y
BR2_PACKAGE_BUSYBOX_CONFIG_FRAGMENT_FILES="$(BR2_EXTERNAL_ANDROID_PATH)/board/samsung-expressatt/busybox-firstlight.fragment"
BR2_PACKAGE_REBOOT_MODE=y
BR2_PACKAGE_UNUDHCPD=y
BR2_PACKAGE_DROPBEAR=y
# BR2_PACKAGE_DROPBEAR_CLIENT is not set
BR2_PACKAGE_DROPBEAR_DISABLE_REVERSEDNS=y
BR2_PACKAGE_I2C_TOOLS=y
BR2_PACKAGE_E2FSPROGS=y
BR2_PACKAGE_E2FSPROGS_RESIZE2FS=y
BR2_PACKAGE_EVTEST=y
BR2_PACKAGE_USBUTILS=y
BR2_PACKAGE_IW=y
BR2_PACKAGE_WIRELESS_REGDB=y
BR2_PACKAGE_HOST_DTC=y
# BR2_TARGET_ROOTFS_TAR is not set
BR2_TARGET_ROOTFS_EXT2=y
BR2_TARGET_ROOTFS_EXT2_2r1=y
BR2_TARGET_ROOTFS_EXT2_LABEL="expressatt"
BR2_TARGET_ROOTFS_EXT2_SIZE="256M"
BR2_TARGET_ROOTFS_EXT2_MKFS_OPTIONS="-O none,filetype,sparse_super,large_file"
```

## buildroot-external/configs/samsung-expressatt_firstlight_defconfig
```kconfig
BR2_arm=y
BR2_cortex_a15=y
BR2_ARM_FPU_NEON_VFPV4=y
BR2_TOOLCHAIN_BUILDROOT_MUSL=y
BR2_KERNEL_HEADERS_AS_KERNEL=y
BR2_PACKAGE_HOST_LINUX_HEADERS_CUSTOM_7_1=y
BR2_TARGET_GENERIC_HOSTNAME="expressatt-firstlight"
BR2_TARGET_GENERIC_ISSUE="Samsung Express first-light initramfs"
BR2_INIT_NONE=y
BR2_ROOTFS_DEVICE_CREATION_DYNAMIC_DEVTMPFS=y
BR2_ROOTFS_OVERLAY="$(BR2_EXTERNAL_ANDROID_PATH)/board/samsung-expressatt/firstlight-overlay"
BR2_ROOTFS_POST_BUILD_SCRIPT="$(BR2_EXTERNAL_ANDROID_PATH)/board/samsung-expressatt/post-build.sh"
BR2_ROOTFS_POST_IMAGE_SCRIPT="$(BR2_EXTERNAL_ANDROID_PATH)/board/samsung-expressatt/post-image.sh"
BR2_LINUX_KERNEL=y
BR2_LINUX_KERNEL_CUSTOM_GIT=y
BR2_LINUX_KERNEL_CUSTOM_REPO_URL="https://git.kernel.org/pub/scm/linux/kernel/git/stable/linux.git"
BR2_LINUX_KERNEL_CUSTOM_REPO_VERSION="5fce161649b4d779d1b76d9fcd52dc77779774b8"
BR2_LINUX_KERNEL_USE_CUSTOM_CONFIG=y
BR2_LINUX_KERNEL_CUSTOM_CONFIG_FILE="$(BR2_EXTERNAL_ANDROID_PATH)/board/samsung-expressatt/linux.config"
BR2_LINUX_KERNEL_CONFIG_FRAGMENT_FILES="$(BR2_EXTERNAL_ANDROID_PATH)/board/samsung-expressatt/linux-firstlight.fragment"
BR2_LINUX_KERNEL_DTS_SUPPORT=y
BR2_LINUX_KERNEL_INTREE_DTS_NAME="qcom/qcom-msm8960-samsung-expressatt"
BR2_PACKAGE_BUSYBOX_CONFIG_FRAGMENT_FILES="$(BR2_EXTERNAL_ANDROID_PATH)/board/samsung-expressatt/busybox-firstlight.fragment"
BR2_PACKAGE_REBOOT_MODE=y
BR2_PACKAGE_UNUDHCPD=y
BR2_PACKAGE_HOST_DTC=y
# BR2_TARGET_ROOTFS_TAR is not set
BR2_TARGET_ROOTFS_CPIO=y
BR2_TARGET_ROOTFS_CPIO_GZIP=y
```

## buildroot-external/configs/tb3_710f_defconfig
```kconfig
BR2_arm=y
BR2_cortex_a7=y
BR2_ARM_FPU_NEON_VFPV4=y
BR2_TOOLCHAIN_BUILDROOT_GLIBC=y
BR2_TOOLCHAIN_BUILDROOT_CXX=y
BR2_KERNEL_HEADERS_6_12=y
BR2_TARGET_GENERIC_HOSTNAME="tb3-710f"
BR2_TARGET_GENERIC_ISSUE="Lenovo Tab3 7 (TB3-710F)"
BR2_TARGET_GENERIC_ROOT_PASSWD="root"
BR2_ROOTFS_DEVICE_CREATION_DYNAMIC_MDEV=y
BR2_TARGET_GENERIC_GETTY_PORT="tty0"
BR2_ROOTFS_OVERLAY="$(BR2_EXTERNAL_ANDROID_PATH)/board/tb3_710f/overlay"
BR2_ROOTFS_POST_IMAGE_SCRIPT="$(BR2_EXTERNAL_ANDROID_PATH)/board/tb3_710f/scripts/create_boot_image.sh"
BR2_LINUX_KERNEL=y
BR2_LINUX_KERNEL_CUSTOM_GIT=y
BR2_LINUX_KERNEL_CUSTOM_REPO_URL="https://github.com/mlainez/linux-mt8127"
BR2_LINUX_KERNEL_CUSTOM_REPO_VERSION="6.18/staging"
BR2_LINUX_KERNEL_USE_CUSTOM_CONFIG=y
BR2_LINUX_KERNEL_CUSTOM_CONFIG_FILE="$(BR2_EXTERNAL_ANDROID_PATH)/board/tb3_710f/linux.config"
BR2_LINUX_KERNEL_DTS_SUPPORT=y
BR2_LINUX_KERNEL_INTREE_DTS_NAME="mediatek/mt8127-lenovo-tb3-710f"
BR2_LINUX_KERNEL_INSTALL_TARGET=y
BR2_PACKAGE_BUSYBOX_SHOW_OTHERS=y
BR2_PACKAGE_BUSYBOX_CONFIG_FRAGMENT_FILES="$(BR2_EXTERNAL_ANDROID_PATH)/board/tb3_710f/busybox.config.fragment"
BR2_PACKAGE_E2FSPROGS=y
BR2_PACKAGE_E2FSPROGS_RESIZE2FS=y
BR2_PACKAGE_I2C_TOOLS=y
BR2_PACKAGE_KMOD=y
BR2_PACKAGE_KMOD_TOOLS=y
BR2_PACKAGE_OPENSSH=y
BR2_PACKAGE_USBUTILS=y
BR2_PACKAGE_TB3_TOOLS=y
# BR2_TARGET_ROOTFS_TAR is not set
BR2_TARGET_ROOTFS_CPIO=y
BR2_TARGET_ROOTFS_CPIO_GZIP=y
BR2_TARGET_ROOTFS_EXT2=y
BR2_TARGET_ROOTFS_EXT2_4=y
BR2_TARGET_ROOTFS_EXT2_LABEL="tb3-root"
BR2_TARGET_ROOTFS_EXT2_SIZE="256M"
BR2_PACKAGE_LIBGPIOD=y
BR2_PACKAGE_LIBGPIOD_TOOLS=y
BR2_PACKAGE_EVTEST=y
BR2_PACKAGE_TB3_FIRMWARE=y
BR2_PACKAGE_MT8127_BTIF=y
BR2_PACKAGE_MT8127_CONSYS=y
BR2_PACKAGE_MT8127_WMT=y
BR2_PACKAGE_MT8127_WLAN=y
BR2_PACKAGE_MT8127_CAMERA=y
BR2_PACKAGE_LIBV4L=y
BR2_PACKAGE_LIBV4L_UTILS=y
BR2_PACKAGE_YAVTA=y
BR2_PACKAGE_ALSA_UTILS=y
BR2_PACKAGE_ALSA_UTILS_ALSACTL=y
BR2_PACKAGE_ALSA_UTILS_AMIXER=y
BR2_PACKAGE_ALSA_UTILS_APLAY=y
BR2_PACKAGE_ALSA_UTILS_SPEAKER_TEST=y
BR2_PACKAGE_LIBEVENT=y
BR2_PACKAGE_LIBCAMERA=y
BR2_PACKAGE_LIBCAMERA_PIPELINE_SIMPLE=y
BR2_PACKAGE_LIBCAMERA_V4L2=y
BR2_PACKAGE_TB3_WIFI=y
BR2_PACKAGE_IW=y
BR2_PACKAGE_WPA_SUPPLICANT_CLI=y
BR2_PACKAGE_WPA_SUPPLICANT_PASSPHRASE=y
BR2_PACKAGE_WIRELESS_REGDB=y
BR2_GLOBAL_PATCH_DIR="$(BR2_EXTERNAL_ANDROID_PATH)/patches"
```

## buildroot-external/package/mt8127-bt/Config.in
```kconfig
config BR2_PACKAGE_MT8127_BT
	bool "mt8127-bt"
	depends on BR2_LINUX_KERNEL
	select BR2_LINUX_NEEDS_MODULES
	select BR2_PACKAGE_MT8127_WMT
	select BR2_PACKAGE_MT8127_CONSYS
	help
	  Bluetooth HCI driver (mtk_consys_bt) for the MT8127 CONSYS, on
	  top of the WMT core. Registers hci0 for BlueZ. Needs the
	  CONFIG_BT kernel options and the CONSYS firmware (tb3-firmware).
```

## buildroot-external/package/mt8127-btif/Config.in
```kconfig
config BR2_PACKAGE_MT8127_BTIF
	bool "mt8127-btif"
	depends on BR2_LINUX_KERNEL
	select BR2_LINUX_NEEDS_MODULES
	help
	  Driver for the BTIF block of the MediaTek MT8127: the UART-like
	  link between the application processor and the CONSYS connectivity
	  subsystem. Provides the mtk_wcn_btif_* API used by the WMT core.
```

## buildroot-external/package/mt8127-camera/Config.in
```kconfig
config BR2_PACKAGE_MT8127_CAMERA
	bool "mt8127-camera"
	depends on BR2_LINUX_KERNEL
	select BR2_LINUX_NEEDS_MODULES
	help
	  V4L2 media-controller camera driver for the MT8127 (camsys:
	  sensor interface, ISP pass 1 and the sensor clock) and the
	  SP2508 / SP0A20 sensor drivers. Needs the media and videobuf2
	  kernel options.
```

## buildroot-external/package/mt8127-camera/src/cam/Kconfig
```kconfig
# SPDX-License-Identifier: GPL-2.0-only
config VIDEO_MT8127_CAMSYS
	tristate "MediaTek MT8127 camera subsystem"
	depends on VIDEO_DEV && OF && ARCH_MEDIATEK && COMMON_CLK
	select MEDIA_CONTROLLER
	select VIDEO_V4L2_SUBDEV_API
	select V4L2_FWNODE
	select VIDEOBUF2_DMA_CONTIG
	help
	  V4L2 capture driver for the sensor interface and ISP pass 1 of the
	  MediaTek MT8127: a CSI-2 receiver, one capture video node and the
	  24 MHz sensor master clock. The SP2508 and SP0A20 sensors are
	  separate drivers.

	  To compile this driver as a module, choose M here: the module will be
	  called mtk_camsys.
```

## buildroot-external/package/mt8127-consys/Config.in
```kconfig
config BR2_PACKAGE_MT8127_CONSYS
	bool "mt8127-consys"
	depends on BR2_LINUX_KERNEL
	select BR2_LINUX_NEEDS_MODULES
	help
	  Platform support for the MT8127 CONSYS connectivity subsystem:
	  PMIC rails, power domain, clock gate, reserved memory and the
	  interrupts of the block. Provides the platform functions the WMT
	  core expects.
```

## buildroot-external/package/mt8127-fm/Config.in
```kconfig
config BR2_PACKAGE_MT8127_FM
	bool "mt8127-fm"
	depends on BR2_LINUX_KERNEL
	select BR2_LINUX_NEEDS_MODULES
	select BR2_PACKAGE_MT8127_WMT
	select BR2_PACKAGE_MT8127_CONSYS
	help
	  FM radio driver (mtk_consys_fm, a V4L2 radio device) for the
	  MT8127 CONSYS, on top of the WMT core, and the fm-radio
	  control tool. Needs the MT6627 FM firmware (tb3-firmware).
```

## buildroot-external/package/mt8127-wlan/Config.in
```kconfig
config BR2_PACKAGE_MT8127_WLAN
	bool "mt8127-wlan"
	depends on BR2_LINUX_KERNEL
	select BR2_LINUX_NEEDS_MODULES
	select BR2_PACKAGE_MT8127_WMT
	help
	  MediaTek gen2 WiFi driver (wlan_mt) for the MT8127 CONSYS, as
	  a cfg80211 driver on top of the WMT core. Needs the CFG80211
	  kernel options and the CONSYS firmware (tb3-firmware).
```

## buildroot-external/package/mt8127-wmt/Config.in
```kconfig
config BR2_PACKAGE_MT8127_WMT
	bool "mt8127-wmt"
	depends on BR2_LINUX_KERNEL
	select BR2_LINUX_NEEDS_MODULES
	select BR2_PACKAGE_MT8127_BTIF
	select BR2_PACKAGE_MT8127_CONSYS
	help
	  MediaTek WMT and STP core for the MT8127 CONSYS: powers the
	  subsystem, loads its patch with request_firmware and multiplexes
	  the WiFi function over the BTIF link. Needs the BTIF and CONSYS
	  platform packages.
```

## buildroot-external/package/s3ve3g-firmware/Config.in
```kconfig
config BR2_PACKAGE_S3VE3G_FIRMWARE
	bool "Samsung Galaxy S III Neo (s3ve3g) firmware"
	help
	  The WCNSS (Pronto) calibration file WCNSS_qcom_wlan_nv.bin for
	  wcn36xx, from LineageOS android_device_samsung_msm8226-common
	  (byte-identical to the stock one).

	  The WCNSS firmware itself (wcnss.mdt, wcnss.b*) is not shipped:
	  the board mounts the phone's apnhlos partition at boot and the
	  kernel loads it from there.
```

## buildroot-external/package/tb3-audio/Config.in
```kconfig
config BR2_PACKAGE_TB3_AUDIO
	bool "tb3-audio"
	depends on BR2_PACKAGE_ALSA_UTILS_ALSACTL
	help
	  Mixer defaults for the TB3-710F sound card (speaker and
	  internal microphone routed, headphone gain -5 dB + 8 dB) and an
	  init script that restores them at boot and saves them at
	  shutdown.
```

## buildroot-external/package/tb3-bluetooth/Config.in
```kconfig
config BR2_PACKAGE_TB3_BLUETOOTH
	bool "tb3-bluetooth"
	depends on BR2_PACKAGE_MT8127_BT
	help
	  Loads the TB3-710F Bluetooth driver at boot with a stable
	  per-device address derived from the eMMC CID.
```

## buildroot-external/package/tb3-firmware/Config.in
```kconfig
config BR2_PACKAGE_TB3_FIRMWARE
	bool "tb3-firmware"
	help
	  Proprietary firmware of the Lenovo TB3-710F: the Silead touch
	  controller image and the CONSYS WiFi files (WMT patches, WiFi
	  RAM code, WMT_SOC.cfg). The files are not redistributable and
	  are taken from a local directory prepared with
	  board/tb3_710f/scripts/prepare_firmware.sh.

if BR2_PACKAGE_TB3_FIRMWARE

config BR2_PACKAGE_TB3_FIRMWARE_DIR
	string "firmware directory"
	default "$(BR2_EXTERNAL_ANDROID_PATH)/board/tb3_710f/firmware"
	help
	  Directory laid out like /lib/firmware that is copied into the
	  target.

endif
```

## buildroot-external/package/tb3-gpu-test/Config.in
```kconfig
config BR2_PACKAGE_TB3_GPU_TEST
	bool "tb3-gpu-test"
	depends on BR2_PACKAGE_MESA3D_OPENGL_EGL
	depends on BR2_PACKAGE_MESA3D_OPENGL_ES
	help
	  Offscreen GPU check for the TB3-710F: renders a triangle through
	  EGL (surfaceless) and GLES2 on the lima render node and verifies the
	  pixels.
```

## buildroot-external/package/tb3-tools/Config.in
```kconfig
config BR2_PACKAGE_TB3_TOOLS
	bool "tb3-tools"
	help
	  Lenovo TB3-710F helpers: PMIC register access through the PMIC
	  wrapper (tb3-pmic) and reboot-mode, which reboots into the
	  bootloader or recovery by marking the PMIC RTC power-down bits
	  that LK reads.
```

## buildroot-external/package/tb3-wifi/Config.in
```kconfig
config BR2_PACKAGE_TB3_WIFI
	bool "tb3-wifi"
	depends on BR2_PACKAGE_MT8127_WLAN
	select BR2_PACKAGE_TB3_FIRMWARE
	select BR2_PACKAGE_WPA_SUPPLICANT
	select BR2_PACKAGE_WPA_SUPPLICANT_NL80211
	help
	  Brings the WiFi of the Lenovo TB3-710F up at boot: loads the
	  CONSYS driver stack in dependency order and starts
	  wpa_supplicant on wlan0 when /etc/wpa_supplicant.conf exists.
```
