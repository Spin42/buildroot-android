## buildroot-external/configs/fairphone2_defconfig
```kconfig
BR2_arm=y
BR2_cortex_a15=y
BR2_ARM_FPU_NEON_VFPV4=y
BR2_PACKAGE_HOST_LINUX_HEADERS_CUSTOM_6_11=y
BR2_GNU_MIRROR="http://ftpmirror.gnu.org"
BR2_ROOTFS_DEVICE_CREATION_DYNAMIC_EUDEV=y
BR2_TARGET_GENERIC_ROOT_PASSWD="root"
BR2_TARGET_GENERIC_GETTY_PORT="tty1"
BR2_ROOTFS_OVERLAY="$(BR2_EXTERNAL_FP2_PATH)/board/fairphone2/overlay"
BR2_ROOTFS_POST_IMAGE_SCRIPT="support/scripts/genimage.sh"
BR2_ROOTFS_POST_SCRIPT_ARGS="-c $(BR2_EXTERNAL_FP2_PATH)/board/fairphone2/genimage.cfg"
BR2_LINUX_KERNEL=y
BR2_LINUX_KERNEL_CUSTOM_GIT=y
BR2_LINUX_KERNEL_CUSTOM_REPO_URL="https://github.com/msm8974-mainline/linux"
BR2_LINUX_KERNEL_CUSTOM_REPO_VERSION="v6.11.4-msm8974"
BR2_LINUX_KERNEL_USE_CUSTOM_CONFIG=y
BR2_LINUX_KERNEL_CUSTOM_CONFIG_FILE="$(BR2_EXTERNAL_FP2_PATH)/board/fairphone2/linux.config"
BR2_LINUX_KERNEL_DTS_SUPPORT=y
BR2_LINUX_KERNEL_INTREE_DTS_NAME="qcom/qcom-msm8974pro-fairphone-fp2"
BR2_LINUX_KERNEL_DTB_OVERLAY_SUPPORT=y
BR2_LINUX_KERNEL_INSTALL_TARGET=y
BR2_PACKAGE_BUSYBOX_SHOW_OTHERS=y
BR2_PACKAGE_E2FSPROGS=y
BR2_PACKAGE_E2FSPROGS_RESIZE2FS=y
BR2_PACKAGE_GENEXT2FS=y
BR2_PACKAGE_LINUX_FIRMWARE=y
BR2_PACKAGE_LINUX_FIRMWARE_QCOM_ADRENO=y
BR2_PACKAGE_KBD=y
BR2_PACKAGE_USBUTILS=y
BR2_PACKAGE_ELL=y
BR2_PACKAGE_BLUEZ_TOOLS=y
BR2_PACKAGE_BLUEZ5_UTILS=y
BR2_PACKAGE_BLUEZ5_UTILS_CLIENT=y
BR2_PACKAGE_BLUEZ5_UTILS_TOOLS=y
BR2_PACKAGE_BLUEZ5_UTILS_PLUGINS_HID=y
BR2_PACKAGE_DHCP=y
BR2_PACKAGE_DHCP_SERVER=y
BR2_PACKAGE_IPTABLES=y
BR2_PACKAGE_MODEM_MANAGER_LIBQRTR=y
BR2_PACKAGE_NETWORK_MANAGER=y
BR2_PACKAGE_NETWORK_MANAGER_TUI=y
BR2_PACKAGE_NETWORK_MANAGER_CLI=y
BR2_PACKAGE_NETWORK_MANAGER_MODEM_MANAGER=y
BR2_PACKAGE_OPENSSH=y
BR2_PACKAGE_WIRELESS_REGDB=y
BR2_PACKAGE_WIRELESS_TOOLS=y
BR2_PACKAGE_WPA_SUPPLICANT=y
BR2_PACKAGE_WPA_SUPPLICANT_AP_SUPPORT=y
BR2_PACKAGE_WPA_SUPPLICANT_EAP=y
BR2_PACKAGE_WPA_SUPPLICANT_WPS=y
BR2_PACKAGE_WPA_SUPPLICANT_WPA3=y
BR2_PACKAGE_WPA_SUPPLICANT_CLI=y
BR2_PACKAGE_WPA_SUPPLICANT_WPA_CLIENT_SO=y
BR2_PACKAGE_WPA_SUPPLICANT_PASSPHRASE=y
BR2_PACKAGE_WPA_SUPPLICANT_DBUS=y
BR2_TARGET_ROOTFS_EXT2=y
BR2_TARGET_ROOTFS_EXT2_3=y
BR2_TARGET_ROOTFS_EXT2_SIZE="250M"
BR2_PACKAGE_HOST_GENIMAGE=y
BR2_PACKAGE_FP2_FIRMWARE=y
BR2_PACKAGE_QRTR=y
BR2_PACKAGE_RMTFS=y
BR2_PACKAGE_SIM_SELECTOR=y
BR2_PACKAGE_FIRST_BOOT_RESIZE=y
```

## buildroot-external/configs/fairphone3_defconfig
```kconfig
BR2_aarch64=y
BR2_cortex_a53=y
BR2_TOOLCHAIN_EXTERNAL=y
BR2_TOOLCHAIN_EXTERNAL_CUSTOM=y
BR2_TOOLCHAIN_EXTERNAL_DOWNLOAD=y
BR2_TOOLCHAIN_EXTERNAL_URL="https://github.com/nerves-project/toolchains/releases/download/v14.2.0/nerves_toolchain_aarch64_nerves_linux_gnu-linux_x86_64-14.2.0-C3B80E7.tar.xz"
BR2_TOOLCHAIN_EXTERNAL_CUSTOM_PREFIX="aarch64-nerves-linux-gnu"
BR2_TOOLCHAIN_EXTERNAL_GCC_14=y
BR2_TOOLCHAIN_EXTERNAL_HEADERS_5_4=y
BR2_TOOLCHAIN_EXTERNAL_CUSTOM_GLIBC=y
BR2_TOOLCHAIN_EXTERNAL_CXX=y
BR2_TOOLCHAIN_EXTERNAL_FORTRAN=y
BR2_TOOLCHAIN_EXTERNAL_HAS_SSP=y
BR2_TOOLCHAIN_EXTERNAL_HAS_SSP_STRONG=y
# BR2_TOOLCHAIN_EXTERNAL_INET_RPC is not set
BR2_TOOLCHAIN_EXTERNAL_OPENMP=y
# No kernel patches - using LINUX_OVERRIDE_SRCDIR
BR2_GNU_MIRROR="http://ftpmirror.gnu.org"
BR2_ROOTFS_DEVICE_CREATION_DYNAMIC_EUDEV=y
BR2_TARGET_GENERIC_ROOT_PASSWD="root"
BR2_TARGET_GENERIC_GETTY_PORT="tty0"
BR2_ROOTFS_OVERLAY="$(BR2_EXTERNAL_ANDROID_PATH)/board/fairphone3/overlay"
BR2_ROOTFS_POST_IMAGE_SCRIPT="support/scripts/genimage.sh"
BR2_ROOTFS_POST_SCRIPT_ARGS="-c $(BR2_EXTERNAL_ANDROID_PATH)/board/fairphone3/genimage.cfg"
BR2_LINUX_KERNEL=y
BR2_LINUX_KERNEL_CUSTOM_GIT=y
BR2_LINUX_KERNEL_CUSTOM_REPO_URL="https://github.com/mlainez/linux-msm8953"
BR2_LINUX_KERNEL_CUSTOM_REPO_VERSION="adsp-sensors"
BR2_LINUX_KERNEL_USE_CUSTOM_CONFIG=y
BR2_LINUX_KERNEL_CUSTOM_CONFIG_FILE="$(BR2_EXTERNAL_ANDROID_PATH)/board/fairphone3/linux.config"
BR2_LINUX_KERNEL_DTS_SUPPORT=y
BR2_LINUX_KERNEL_INTREE_DTS_NAME="qcom/sdm632-fairphone-fp3"
BR2_LINUX_KERNEL_DTB_OVERLAY_SUPPORT=y
BR2_LINUX_KERNEL_INSTALL_TARGET=y
BR2_PACKAGE_BUSYBOX_SHOW_OTHERS=y
BR2_PACKAGE_E2FSPROGS=y
BR2_PACKAGE_E2FSPROGS_RESIZE2FS=y
BR2_PACKAGE_GENEXT2FS=y
BR2_PACKAGE_LINUX_FIRMWARE=y
BR2_PACKAGE_LINUX_FIRMWARE_QCOM_ADRENO=y
BR2_PACKAGE_KBD=y
BR2_PACKAGE_USBUTILS=y
BR2_PACKAGE_ELL=y
BR2_PACKAGE_BLUEZ_TOOLS=y
BR2_PACKAGE_BLUEZ5_UTILS=y
BR2_PACKAGE_BLUEZ5_UTILS_CLIENT=y
BR2_PACKAGE_BLUEZ5_UTILS_TOOLS=y
BR2_PACKAGE_BLUEZ5_UTILS_PLUGINS_HID=y
BR2_PACKAGE_DHCP=y
BR2_PACKAGE_DHCP_SERVER=y
BR2_PACKAGE_IPTABLES=y
BR2_PACKAGE_MODEM_MANAGER_LIBQRTR=y
BR2_PACKAGE_NETWORK_MANAGER=y
BR2_PACKAGE_NETWORK_MANAGER_TUI=y
BR2_PACKAGE_NETWORK_MANAGER_CLI=y
BR2_PACKAGE_NETWORK_MANAGER_MODEM_MANAGER=y
BR2_PACKAGE_OPENSSH=y
BR2_PACKAGE_WIRELESS_REGDB=y
BR2_PACKAGE_WIRELESS_TOOLS=y
BR2_PACKAGE_WPA_SUPPLICANT=y
BR2_PACKAGE_WPA_SUPPLICANT_AP_SUPPORT=y
BR2_PACKAGE_WPA_SUPPLICANT_EAP=y
BR2_PACKAGE_WPA_SUPPLICANT_WPS=y
BR2_PACKAGE_WPA_SUPPLICANT_WPA3=y
BR2_PACKAGE_WPA_SUPPLICANT_CLI=y
BR2_PACKAGE_WPA_SUPPLICANT_WPA_CLIENT_SO=y
BR2_PACKAGE_WPA_SUPPLICANT_PASSPHRASE=y
BR2_PACKAGE_WPA_SUPPLICANT_DBUS=y
BR2_TARGET_ROOTFS_EXT2=y
BR2_TARGET_ROOTFS_EXT2_3=y
BR2_TARGET_ROOTFS_EXT2_SIZE="500M"
BR2_PACKAGE_HOST_GENIMAGE=y
BR2_PACKAGE_QRTR=y
BR2_PACKAGE_RMTFS=y
BR2_PACKAGE_SIM_SELECTOR=y
BR2_PACKAGE_FIRST_BOOT_RESIZE=y
BR2_PACKAGE_UNUDHCPD=y
BR2_PACKAGE_FP3_FIRMWARE=y
BR2_PACKAGE_TQFTPSERV=y
BR2_PACKAGE_HEXAGONRPC=y
BR2_PACKAGE_REBOOT_MODE=y
```

## buildroot-external/package/adsp-boot/Config.in
```kconfig
config BR2_PACKAGE_ADSP_BOOT
	bool "adsp-boot"
	help
	  Init script to boot the ADSP remoteproc after all required
	  services (pd_mapper, tqftpserv, rmtfs, hexagonrpc) are ready.
	  Loads required kernel modules and starts the ADSP.
```

## buildroot-external/package/alsa-ucm-conf/Config.in
```kconfig
config BR2_PACKAGE_ALSA_UCM_CONF
	bool "alsa-ucm-conf"
	help
	  Install ALSA Use Case Manager (UCM) configuration files from GitHub.
```

## buildroot-external/package/citronics-initramfs/Config.in
```kconfig
config BR2_PACKAGE_CITRONICS_INITRAMFS
        bool "Citronics initramfs"
        depends on !BR2_STATIC_LIBS
        depends on BR2_USE_MMU
        depends on BR2_TOOLCHAIN_HAS_THREADS
        select BR2_TOOLCHAIN_BUILDROOT_CXX
        select BR2_PACKAGE_BUSYBOX
        select BR2_PACKAGE_UNUDHCPD
        select BR2_PACKAGE_MULTIPATH_TOOLS
        select BR2_PACKAGE_PARTED
        select BR2_PACKAGE_E2FSPROGS
        select BR2_PACKAGE_E2FSPROGS_RESIZE2FS
        select BR2_PACKAGE_UTIL_LINUX_BINARIES
        help
          Builds and installs citronics initramfs.
```

## buildroot-external/package/citros-initramfs/Config.in
```kconfig
config BR2_PACKAGE_CITROS_INITRAMFS
        bool "Citros Initramfs"
        help
          This initramfs uses special kernel command line parameters and kpartx to mount subpartitions in case the boot partition and system partitions were flashed inside an existing partition.
```

## buildroot-external/package/first-boot-resize/Config.in
```kconfig
config BR2_PACKAGE_FIRST_BOOT_RESIZE
        bool "First boot rootfs resize"
        help
          One-time service to resize root filesystem
```

## buildroot-external/package/fp2-firmware/Config.in
```kconfig
config BR2_PACKAGE_FP2_FIRMWARE
        bool "Fairphone 2 Firmware"
        help
          This package provides all firmware binaries for Fairphone 2.
```

## buildroot-external/package/fp3-firmware/Config.in
```kconfig
config BR2_PACKAGE_FP3_FIRMWARE
	bool "Fairphone 3 Firmware"
	help
	  This package provides all firmware binaries for Fairphone 3.
```

## buildroot-external/package/grate-firmware/Config.in
```kconfig
config BR2_PACKAGE_GRATE_FIRMWARE
        bool "Grate Firmware"
        help
          This package provides all firmware binaries for Grate devices.
```

## buildroot-external/package/hexagonrpc/Config.in
```kconfig
config BR2_PACKAGE_HEXAGONRPC
	bool "Hexagon FastRPC userspace (hexagonrpc)"
	help
	  Hexagon FastRPC userspace implementation providing hexagonrpcd
	  (reverse tunnel daemon for DSP file/memory serving), chrecd
	  (Context Hub Runtime Environment client), and libhexagonrpc.

	  https://github.com/linux-msm/hexagonrpc
```

## buildroot-external/package/qrtr/Config.in
```kconfig
config BR2_PACKAGE_QRTR
        bool "Qualcomm IPC Router userspace reference (QRTR)"
        help
          Userspace reference for net/qrtr in the Linux kernel.
```

## buildroot-external/package/reboot-mode/Config.in
```kconfig
config BR2_PACKAGE_REBOOT_MODE
	bool "reboot-mode"
	help
	  Small utility to reboot into a specific mode (bootloader,
	  recovery, edl). Uses LINUX_REBOOT_CMD_RESTART2 which on
	  Qualcomm devices triggers the bootloader to enter the
	  requested mode.
```

## buildroot-external/package/rmtfs/Config.in
```kconfig
config BR2_PACKAGE_RMTFS
        bool "Qualcomm Remote Filesystem Service (RMTFS)"
	depends on BR2_PACKAGE_QRTR
        help
          Qualcomm Remote Filesystem Service Implementation.
```

## buildroot-external/package/rpmsgexport/Config.in
```kconfig
config BR2_PACKAGE_RPMSGEXPORT
        bool "rpmsgexport"
        help
          Create rpmsg endpoint devices.
```

## buildroot-external/package/sim-selector/Config.in
```kconfig
config BR2_PACKAGE_SIM_SELECTOR
        bool "SIM card selector service"
        help
          Waits for the modem to be present and selects the used sim card slot that has a sim card present.
```

## buildroot-external/package/tqftpserv/Config.in
```kconfig
config BR2_PACKAGE_TQFTPSERV
	bool "Qualcomm Trivial QFTP Server (tqftpserv)"
	depends on BR2_PACKAGE_QRTR
	select BR2_PACKAGE_ZSTD
	help
	  TFTP-like server that serves firmware files to Qualcomm remote
	  processors (modem, ADSP, etc.) over the QRTR IPC transport.

	  https://github.com/linux-msm/tqftpserv
```

## buildroot-external/package/unudhcpd/Config.in
```kconfig
config BR2_PACKAGE_UNUDHCPD
        bool "Unudhcpd"
        help
          Dhcp server that delivers only one IP.
```
